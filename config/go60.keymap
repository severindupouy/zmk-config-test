#include "settings.h" // your options
#define SELENIUM_KEYMAP_BINDINGS(LOUT1,  LROW1,  RROW1,  ROUT1, \
                                 LOUT2,  LROW2,  RROW2,  ROUT2, \
                                 LOUT3,  LROW3,  RROW3,  ROUT3, \
                                 LT1, LT2, LT3,  RT3, RT2, RT1) \
    &kp EQUAL &kp N1 &kp N2 &kp N3 &kp N4 &kp N5 &kp N6 &kp N7 &kp N8 &kp N9 &kp N0 &kp MINUS \
    LOUT1     LROW1                                                          RROW1  ROUT1     \
    LOUT2     LROW2                                                          RROW2  ROUT2     \
    LOUT3     LROW3                                                          RROW3  ROUT3     \
                     &none  &none  &none                &none  &none  &none                   \
                                LT1  LT2  LT3      RT3  RT2  RT1

#include <aekeynox/selenium.keymap>
