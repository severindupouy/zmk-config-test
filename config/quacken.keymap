#include "settings.h" // your options
#include <aekeynox/selenium.keymap>

// The fork of ZMK we rely on adds a redirection-table feature. This allows the
// user to easilly adapt the keymap to non-standard key configurations. Here are
// a handful of examples for the more common use-cases (uncomment to activate them):

// "Swallow" config
// &default_transform {
//   redirection-table = <
//      0 12  2  3  4  5     6  7  8  9 23 11
//      1 13 14 15 16 17    18 19 20 21 22 10
//     24 25 26 27 28 29    30 31 32 33 34 35
//              36 37 38    39 40 41
//   >;
// };

// "Swift" config
// &default_transform {
//   redirection-table = <
//     25  1  2  3  4  5     6  7  8  9 10 34
//     12 13 14 15 16 17    18 19 20 21 22 23
//     24  0 26 27 28 29    30 31 32 33 11 35
//              36 37 38    39 40 41
//   >;
// };

// Original definition of the matrix-transform can be found here:
// https://github.com/Nuclear-Squid/zmk-keyboard-quacken/blob/main/boards/ergonautes/quacken_flex/quacken_flex.dts#L19-L29

